## main/Kconfig.projbuild
```kconfig
menu "Camera Application Configuration"

    config ESP_WIFI_SSID
        string "WiFi SSID"
        default "myssid"
        help
            SSID (network name) for the camera to connect to.

    config ESP_WIFI_PASSWORD
        string "WiFi Password"
        default "mypassword"
        help
            WiFi password (WPA or WPA2) for the camera to use.

    config ESP_MAXIMUM_RETRY
        int "Maximum retry"
        default 5
        help
            Set the Maximum retry to avoid station reconnecting to the AP unlimited when the AP is really inexistent.

    choice ESP_WIFI_SCAN_AUTH_MODE_THRESHOLD
        prompt "WiFi Scan auth mode threshold"
        default ESP_WIFI_AUTH_WPA2_PSK
        help
            The weakest authmode to accept in the scan mode.

        config ESP_WIFI_AUTH_OPEN
            bool "OPEN"
        config ESP_WIFI_AUTH_WEP
            bool "WEP"
        config ESP_WIFI_AUTH_WPA_PSK
            bool "WPA PSK"
        config ESP_WIFI_AUTH_WPA2_PSK
            bool "WPA2 PSK"
        config ESP_WIFI_AUTH_WPA_WPA2_PSK
            bool "WPA/WPA2 PSK"
        config ESP_WIFI_AUTH_WPA3_PSK
            bool "WPA3 PSK"
        config ESP_WIFI_AUTH_WPA2_WPA3_PSK
            bool "WPA2/WPA3 PSK"
        config ESP_WIFI_AUTH_WAPI_PSK
            bool "WAPI PSK"
    endchoice

    choice ESP_WIFI_SAE_MODE
        prompt "WPA3 SAE mode selection"
        default ESP_WPA3_SAE_PWE_BOTH
        help
            Select mode for SAE as Hunt and Peck, H2E or both.
        config ESP_WPA3_SAE_PWE_HUNT_AND_PECK
            bool "HUNT AND PECK"
        config ESP_WPA3_SAE_PWE_HASH_TO_ELEMENT
            bool "H2E"
        config ESP_WPA3_SAE_PWE_BOTH
            bool "BOTH"
    endchoice

    config ESP_WIFI_PW_ID
        string "PASSWORD IDENTIFIER"
        depends on ESP_WPA3_SAE_PWE_HASH_TO_ELEMENT || ESP_WPA3_SAE_PWE_BOTH
        default ""
        help
            password identifier for SAE H2E

    config MDNS_HOSTNAME
        string "mDNS Hostname"
        default "esp-camera"
        help
            Hostname for mDNS service. The device will be accessible at http://hostname.local

    config MDNS_INSTANCE
        string "mDNS Instance Name"
        default "ESP32-P4 Camera"
        help
            Instance name for mDNS service advertisement

    config CAMERA_I2C_PORT
        int "Camera I2C Port"
        default 0
        help
            I2C port number for camera sensor communication

    config CAMERA_SCL_PIN
        int "Camera I2C SCL Pin"
        default 8
        help
            GPIO pin for I2C SCL (clock)

    config CAMERA_SDA_PIN
        int "Camera I2C SDA Pin"
        default 7
        help
            GPIO pin for I2C SDA (data)

    config CAMERA_FRAME_WIDTH
        int "Desired sensor frame width (pixels)"
        default 1920
        help
            Preferred horizontal resolution requested from the OV5647 sensor. Set 0 to auto-select.

    config CAMERA_FRAME_HEIGHT
        int "Desired sensor frame height (pixels)"
        default 1080
        help
            Preferred vertical resolution requested from the OV5647 sensor. Set 0 to auto-select.

    config APP_ENABLE_STREAMING
        bool "Enable HTTP streaming server"
        default n
        help
            Enable the existing MJPEG streaming web server. Disable this if you only want face detection with MQTT.

    config APP_ENABLE_FACE_DETECTION
        bool "Enable face detection pipeline"
        default y
        help
            Run the neural-network-based face detection task and publish detections over MQTT.

    if APP_ENABLE_FACE_DETECTION

    config MQTT_BROKER_URI
        string "MQTT broker URI"
        default "mqtt://10.0.0.13:1883"
        help
            URI for the MQTT broker used to publish face detection events.

    config MQTT_USERNAME
        string "MQTT username"
        default "mqtt_user"
        help
            Username for authenticating with the MQTT broker (leave empty for anonymous access).

    config MQTT_PASSWORD
        string "MQTT password"
        default "kuzey2011"
        help
            Password for the MQTT broker account.

    config MQTT_TOPIC_FACE_EVENTS
        string "MQTT topic for face events"
        default "/esp32p4/face/events"
        help
            Topic where face detection payloads will be published.

    config FACE_DET_MIN_INTERVAL_MS
        int "Minimum interval between detections (ms)"
        default 250
        help
            Minimum delay between consecutive detections to limit CPU usage. Set to 0 to process every frame.

    config FACE_DET_TASK_STACK_SIZE
        int "Face detection task stack size"
        default 8192
        help
            Stack size (in bytes) for the face detection task.

    config FACE_DET_TASK_PRIORITY
        int "Face detection task priority"
        default 5
        help
            FreeRTOS priority for the face detection task.

    config FACE_DET_BUFFER_COUNT
        int "Face detection buffer count"
        default 3
        help
            Number of V4L2 buffers to use for the detection pipeline. Increase this if detection is too slow.

    config FACE_DET_ISP_WIDTH
        int "ISP output width (pixels)"
        default 640
        help
            Width to request from the ISP when converting RAW to RGB/YUV. Set to 0 to keep sensor resolution.

    config FACE_DET_ISP_HEIGHT
        int "ISP output height (pixels)"
        default 480
        help
            Height to request from the ISP when converting RAW to RGB/YUV. Set to 0 to keep sensor resolution.

    config FACE_DET_LOG_LATENCY
        bool "Log detailed detector latency"
        default n
        help
            Enable verbose latency measurements printed by the face detection model.

    endif

endmenu
```

## sdkconfig.defaults
```kconfig
# ESP32-P4 Configuration
CONFIG_IDF_TARGET="esp32p4"

# Enable PSRAM
CONFIG_SPIRAM=y
CONFIG_SPIRAM_MODE_OCT=y
CONFIG_SPIRAM_SPEED_200M=y

# Camera sensor configuration
CONFIG_CAMERA_OV5647=y
CONFIG_CAMERA_OV5647_AUTO_DETECT_MIPI_INTERFACE_SENSOR=y

# MIPI CSI Configuration
CONFIG_ESP_VIDEO=y
CONFIG_ESP_VIDEO_ENABLE_MIPI_CSI_VIDEO_DEVICE=y

# WiFi Configuration (via esp-hosted)
CONFIG_ESP_WIFI_REMOTE_LIBRARY_HOSTED=y

# WiFi Station Configuration
CONFIG_ESP_WIFI_SSID="myssid"
CONFIG_ESP_WIFI_PASSWORD="mypassword"
CONFIG_ESP_MAXIMUM_RETRY=5
CONFIG_ESP_WIFI_SCAN_AUTH_MODE_THRESHOLD=3
CONFIG_ESP_WIFI_AUTH_WPA2_PSK=y
CONFIG_ESP_WPA3_SAE_PWE_BOTH=y

# Network configuration
CONFIG_LWIP_LOCAL_HOSTNAME="esp-camera"

# Enable example connection
CONFIG_EXAMPLE_CONNECT_WIFI=y

# HTTP Server Configuration
CONFIG_HTTPD_MAX_REQ_HDR_LEN=1024
CONFIG_HTTPD_MAX_URI_LEN=512

# FreeRTOS Configuration
CONFIG_FREERTOS_HZ=1000
CONFIG_FREERTOS_WATCHPOINT_END_OF_STACK=y

# Logging
CONFIG_LOG_DEFAULT_LEVEL_INFO=y
CONFIG_LOG_MAXIMUM_LEVEL_VERBOSE=y

# Main task stack size
CONFIG_ESP_MAIN_TASK_STACK_SIZE=8192

# Partition table
CONFIG_PARTITION_TABLE_SINGLE_APP_LARGE=y

# mDNS
CONFIG_MDNS_HOSTNAME="esp-camera"
CONFIG_MDNS_INSTANCE="ESP32-P4 Camera"

# Camera I2C Configuration
CONFIG_CAMERA_I2C_PORT=0
CONFIG_CAMERA_SCL_PIN=8
CONFIG_CAMERA_SDA_PIN=7

# ESP-Hosted configuration
CONFIG_ESP_HOSTED_ENABLED=y
CONFIG_ESP_HOSTED_P4_DEV_BOARD_FUNC_BOARD=y
CONFIG_ESP_HOSTED_SDIO_HOST_INTERFACE=y
```
